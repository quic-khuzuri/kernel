// SPDX-License-Identifier: BSD-3-Clause
/*
 * Copyright (c) 2024, Qualcomm Innovation Center, Inc. All rights reserved.
 */
/dts-v1/;

#include "lemans.dtsi"
#include "lemans-pmics.dtsi"

#include "lemans-ride-common.dtsi"
#include "lemans-ride-ethernet-88ea1512.dtsi"

/ {
	model = "Qualcomm Technologies, Inc. Lemans Ride";
	compatible = "qcom,qcs9100-ride", "qcom,qcs9100", "qcom,sa8775p";
};

/* QCS9100 (NORD) UFS configuration override */
&ufs_mem_hc {
	/* NORD: limit to HS-G3 until gear-4 PHY tuning is complete */
	qcom,phy-submode = <0x2>;
	status = "okay";
};
